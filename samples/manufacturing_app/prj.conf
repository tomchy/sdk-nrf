## CMakeLists.txt
```
#
# Copyright (c) 2026 Nordic Semiconductor ASA
#
# SPDX-License-Identifier: LicenseRef-Nordic-5-Clause
#
cmake_minimum_required(VERSION 3.20.0)

find_package(Zephyr REQUIRED HINTS $ENV{ZEPHYR_BASE})

project(manufacturing_app)

# ---------------------------------------------------------------------------
# Include path for application headers
# ---------------------------------------------------------------------------
target_include_directories(app PRIVATE
  src
  ${ZEPHYR_MCUBOOT_MODULE_DIR}/boot/bootutil/include
)

# ---------------------------------------------------------------------------
# Expose the keys/ directory path as a string literal available at runtime.
# ---------------------------------------------------------------------------
file(RELATIVE_PATH _keys_rel ${WEST_TOPDIR} ${CMAKE_CURRENT_SOURCE_DIR}/keys)
target_compile_definitions(app PRIVATE
  SAMPLE_KEYS_DIR="WEST_TOPDIR/${_keys_rel}"
)

# ---------------------------------------------------------------------------
# Application sources
# ---------------------------------------------------------------------------
target_sources(app PRIVATE
  src/main.c
  src/mfg_key_blob.c
  src/recovery.c
  src/kmu_check.c
  src/image_validation.c
  src/key_provisioning.c
  src/erase_protection.c
  src/huk_provisioning.c
  src/product_tests.c
  src/asset_provisioning.c
)
zephyr_link_libraries(MCUBOOT_BOOTUTIL)
```

## prj.conf
```kconfig
#
# Copyright (c) 2026 Nordic Semiconductor ASA
#
# SPDX-License-Identifier: LicenseRef-Nordic-5-Clause
#

# Console and logging
CONFIG_CONSOLE=y
CONFIG_LOG=y
CONFIG_LOG_MODE_IMMEDIATE=y

# LCS (Life Cycle State) subsystem
CONFIG_NRF_LCS=y
# The bl_storage backend supplies the nrf_lcs_mem_*() symbols that
# nrf_lcs.c calls. SECURE_BOOT_STORAGE pulls subsys/bootloader/bl_storage
# into the build; NRF_LCS_MEM_BL_STORAGE then activates the
# nrf_lcs_mem_* implementations inside bl_storage.c.
CONFIG_SECURE_BOOT_STORAGE=y
CONFIG_NRF_LCS_MEM_BL_STORAGE=y
# Suppress INFO-level lcs log messages (e.g. "Performing LCS transition ...").
# The manufacturing app already logs the LCS state explicitly via MFG_LOG_KV,
# so the subsystem's informational messages are redundant. Errors are kept.
CONFIG_NRF_LCS_LOG_LEVEL_ERR=y

# nRF Security / CRACEN PSA Crypto driver
CONFIG_PSA_CRYPTO=y
CONFIG_MBEDTLS_PSA_CRYPTO_C=y
CONFIG_PSA_CRYPTO_DRIVER_OBERON=n
CONFIG_PSA_CRYPTO_DRIVER_CRACEN=y

# CRACEN Internal Key Generator (IKG seed provisioning)
CONFIG_CRACEN_IKG=y

# Do not auto-provision or push the protected RAM invalidation slots during
# psa_crypto_init(). The manufacturing app provisions slots 248/249 manually
# in Step 7. The push is deferred until after provisioning so that
# psa_crypto_init() succeeds on a virgin device.
CONFIG_CRACEN_PROVISION_PROT_RAM_INV_SLOTS_ON_INIT=n
CONFIG_CRACEN_PUSH_PROT_RAM_INV_SLOTS_ON_INIT=ns
# Allow Step 7 to provision slots 248/249 via psa_import_key(). CRACEN ignores
# the provided key material and generates 256 bits of hardware random data,
# provisioning both slots atomically.
# TODO: Update to use externally provided random data once the CRACEN driver
# supports importing caller-supplied material into PROTECTED-scheme slots.
CONFIG_CRACEN_PROVISION_PROT_RAM_INV_SLOTS_WITH_IMPORT=y

# Hardware Unique Key API (used to provision IKG seed with supplied data)
CONFIG_HW_UNIQUE_KEY=y
# Disable automatic seed generation on crypto init. The manufacturing app
# provisions the seed manually in Step 8.
CONFIG_HW_UNIQUE_KEY_WRITE_ON_CRYPTO_INIT=n

# PSA algorithms and key types needed by the manufacturing flow
CONFIG_PSA_WANT_ALG_SHA_256=y
CONFIG_PSA_WANT_ALG_SHA_512=y
CONFIG_PSA_WANT_ALG_ECDSA=y
CONFIG_PSA_WANT_ALG_PURE_EDDSA=y
CONFIG_PSA_WANT_KEY_TYPE_ECC_PUBLIC_KEY=y
CONFIG_PSA_WANT_KEY_TYPE_ECC_KEY_PAIR_EXPORT=y
CONFIG_PSA_WANT_ECC_TWISTED_EDWARDS_255=y
CONFIG_PSA_WANT_ECC_SECP_R1_256=y
CONFIG_PSA_WANT_GENERATE_RANDOM=y

# Flash subsystem (manufacturing TLV is read via the Zephyr flash driver)
CONFIG_FLASH=y
CONFIG_FLASH_MAP=y
CONFIG_MCUBOOT_BOOTUTIL_LIB=y

# Stack size
CONFIG_MAIN_STACK_SIZE=4096
CONFIG_SYSTEM_WORKQUEUE_STACK_SIZE=2048

# Reboot support (used in Step 12)
CONFIG_REBOOT=y
```

## src/main.c
```c
/*
 * Copyright (c) 2026 Nordic Semiconductor ASA.
 *
 * SPDX-License-Identifier: LicenseRef-Nordic-5-Clause
 */

/**
 * @file main.c
 *
 * Manufacturing application: 12-step provisioning flow for nRF54LV10A.
 *
 * Overview
 * --------
 * This application is a reference implementation of the manufacturing flow
 * for Nordic Semiconductor devices using CRACEN.
 *
 * LCS-aware execution
 * -------------------
 * The main switch dispatches to one of two handlers based on the current
 * Lifecycle State:
 *
 *   NRF_LCS_ASSEMBLY_AND_TEST     -> assembly_and_test_handler()  (Steps 2–6)
 *   NRF_LCS_PSA_ROT_PROVISIONING  -> psa_rot_provisioning_handler() (Steps 7–12)
 *
 * Execution flow
 * --------------
 * Assembly and Test state:
 *   Step  2: Validate no IKG seed or KeyRAM random present.
 *   Step  3: Validate digests of all sub-images.
 *   Step  4: Provision and verify secure-boot and ADAC public keys.
 *   Step  5: Block erase-all via UICR.ERASEPROTECT (if CONFIG_SAMPLE_BLOCK_ERASE_ALL).
 *   Step  6: Advance LCS to 'PROT Provisioning'.
 *
 * PROT Provisioning state:
 *   Step  7: Provision KeyRAM random data (KMU slots 248, 249).
 *   Step  8: Provision IKG seed; log IAK / MKEK / MEXT identifiers.
 *   Step  9: End product tests (placeholder: customise for your product).
 *   Step 10: Provision remaining assets and device enrolment (placeholder).
 *   Step 11: Advance LCS to 'Secured'.
 *   Step 12: Revoke manufacturing app key; reboot to install target application.
 */

#include <zephyr/kernel.h>
#include <zephyr/logging/log.h>
#include <zephyr/sys/reboot.h>
#include <nrf_lcs/nrf_lcs.h>

#include "mfg_key_blob.h"
#include "mfg_log.h"
#include "recovery.h"
#include "kmu_check.h"
#include "image_validation.h"
#include "key_provisioning.h"
#include "erase_protection.h"
#include "huk_provisioning.h"
#include "product_tests.h"
#include "asset_provisioning.h"

LOG_MODULE_REGISTER(manufacturing_app, LOG_LEVEL_DBG);

static const char *lcs_to_str(enum nrf_lcs state)
{
	switch (state) {
	case NRF_LCS_ASSEMBLY_AND_TEST:    return "Assembly and Test";
	case NRF_LCS_PSA_ROT_PROVISIONING: return "PSA RoT Provisioning";
	case NRF_LCS_SECURED:              return "Secured";
	case NRF_LCS_DECOMMISSIONED:       return "Decommissioned";
	case NRF_LCS_UNKNOWN:              return "Unknown";
	default:                           return "<invalid>";
	}
}

static void step1_lcs_check(void)
{
	enum nrf_lcs lcs = nrf_lcs_get();

	MFG_LOG_STEP("Checking LCS");
	MFG_LOG_KV("lcs", lcs_to_str(lcs));

	if (lcs != NRF_LCS_ASSEMBLY_AND_TEST &&
	    lcs != NRF_LCS_PSA_ROT_PROVISIONING) {
		MFG_LOG_ERR("Manufacturing application is not allowed to run in LCS '%s'.\n",
			    lcs_to_str(lcs));
		MFG_LOG_ERR("Expected ASSEMBLY_AND_TEST or PSA_ROT_PROVISIONING. "
			    "If LCS is SECURED or DECOMMISSIONED this indicates "
			    "a serious defect in the second-stage bootloader.\n");
		recovery_suspend(false);
	}
}

/* Wrap nrf_lcs_set() with a read-back so that a silently failed
 * transition (glitch / tamper / hardware fault) suspends immediately
 * instead of letting the caller continue in the wrong state.
 */
static void lcs_set_and_verify(enum nrf_lcs target, const char *step_name)
{
	enum nrf_lcs actual;

	MFG_LOG_STEP(step_name);
	nrf_lcs_set(target);

	actual = nrf_lcs_get();
	MFG_LOG_KV("lcs", lcs_to_str(actual));

	if (actual != target) {
		MFG_LOG_ERR("LCS transition failed: requested '%s', read back '%s'\n",
			    lcs_to_str(target), lcs_to_str(actual));
		recovery_suspend(false);
	}
}

static int assembly_and_test_handler(void)
{
	/* Step 2: Validate no IKG seed or KeyRAM random present */
	step2_kmu_check_empty();

	/* Step 3: Validate sub-image digests */
	step3_image_validate_all();

	/* Step 4: Provision secure-boot and ADAC keys */
	step4_key_provision_all();

	/* Step 5: Block erase-all via UICR.ERASEPROTECT */
	step5_erase_block_if_needed();

	/* Step 6: Advance LCS to 'PROT Provisioning' */
	lcs_set_and_verify(NRF_LCS_PSA_ROT_PROVISIONING,
			   "Transitioning LCS to 'PSA RoT Provisioning'");

	return 0;
}

static int psa_rot_provisioning_handler(void)
{
	/* Step 7: Provision KeyRAM random data */
	step7_provision_keyram_random();

	/* Step 8: Provision IKG seed */
	step8_huk_provision_ikg_seed();

	/* Step 9: End product tests */
	step9_tests_run();

	/* Step 10: Provision remaining assets */
	step10_assets_provision();

	/* Step 11: Advance LCS to 'Secured' */
	lcs_set_and_verify(NRF_LCS_SECURED,
			   "Transitioning LCS to 'Secured'");

	/* Step 12: Revoke manufacturing app key and reboot. */
	MFG_LOG_STEP("Cleaning up");
	step12_key_revoke_mfg_key();

	MFG_LOG_INF("\nManufacturing process is completed. The device is about to reboot\n");
	MFG_LOG_INF("and the target application will be installed.\n");
	MFG_LOG_DONE(true);

	k_sleep(K_MSEC(100));
	sys_reboot(SYS_REBOOT_COLD);

	return 0;
}

int main(void)
{
	if (mfg_key_blob_get() == NULL) {
		MFG_LOG_ERR("Manufacturing key blob TLV is missing or invalid.\n");
		MFG_LOG_ERR("Use a signed manufacturing image that embeds the key blob (see README).\n");
		recovery_suspend(false);
	}

	/*
	 * TODO: Remove once BL1/NSIB provisions the manufacturing app key.
	 * CONFIG_SAMPLE_MFG_APP_KEY_KMU_SLOT before this application runs. This call
	 * is a temporary workaround that makes the sample self-contained.
	 */
	key_provision_mfg_app_key();

	/* Step 1: Check LCS. nrf_lcs_get() reads OTP directly; no PSA init required. */
	step1_lcs_check();

	if (nrf_lcs_get() == NRF_LCS_ASSEMBLY_AND_TEST) {
		int ret = assembly_and_test_handler();

		if (ret != 0) {
			MFG_LOG_ERR("Assembly and test handler failed (err=%d)\n", ret);
			MFG_LOG_DONE(false);
			return ret;
		}
	}

	if (nrf_lcs_get() == NRF_LCS_PSA_ROT_PROVISIONING) {
		int ret = psa_rot_provisioning_handler();

		if (ret != 0) {
			MFG_LOG_ERR("PSA RoT provisioning handler failed (err=%d)\n", ret);
			MFG_LOG_DONE(false);
			return ret;
		}

		return 0;
	}

	MFG_LOG_ERR("Device in an unbootable LCS: %s\n", lcs_to_str(nrf_lcs_get()));
	recovery_suspend(false);
}
```

## src/config_implementation_id.h
```c
/*
 * Copyright (c) 2026 Nordic Semiconductor ASA.
 *
 * SPDX-License-Identifier: LicenseRef-Nordic-5-Clause
 */

#pragma once

/* For a different implementation id, application's are expected to
 * create their own config_implementation_id.h header file and ensure
 * it is placed earlier than this header on the include path.
 */

uint8_t implementation_id_in_flash[32] = {
	0xAA, 0xAA, 0xAA, 0xAA, 0xAA, 0xAA, 0xAA, 0xAA,
	0xBB, 0xBB, 0xBB, 0xBB, 0xBB, 0xBB, 0xBB, 0xBB,
	0xCC, 0xCC, 0xCC, 0xCC, 0xCC, 0xCC, 0xCC, 0xCC,
	0xDD, 0xDD, 0xDD, 0xDD, 0xDD, 0xDD, 0xDD, 0xDD
};
```

## src/image_validation.c
```c
/*
 * Copyright (c) 2026 Nordic Semiconductor ASA
 *
 * SPDX-License-Identifier: LicenseRef-Nordic-5-Clause
 */

/**
 * Step 3: Image digest validation.
 */

#include "image_validation.h"
#include "mfg_key_blob.h"
#include "mfg_log.h"
#include "recovery.h"

#include <bootutil/bootutil_public.h>
#include <errno.h>
#include <string.h>
#include <psa/crypto.h>
#include <zephyr/device.h>
#include <zephyr/devicetree.h>
#include <zephyr/drivers/flash.h>
#include <zephyr/storage/flash_map.h>
#include <zephyr/sys/util.h>

#define HASH_CHUNK_SIZE      1024U
#define IMAGE_SHA512_HASH_LEN 64U

#define FLASH_DEV      DEVICE_DT_GET(DT_CHOSEN(zephyr_flash))
#define CODE_PARTITION DT_CHOSEN(zephyr_code_partition)
#define CODE_FLASH     DEVICE_DT_GET(PARTITION_NODE_MTD(CODE_PARTITION))
#define CODE_PART_OFF  PARTITION_NODE_OFFSET(CODE_PARTITION)

BUILD_ASSERT(DT_NODE_EXISTS(DT_CHOSEN(zephyr_flash)),
	     "zephyr,flash chosen node is required for digest verification");
BUILD_ASSERT(DT_NODE_EXISTS(CODE_PARTITION),
	     "zephyr,code-partition is required for manufacturing app self-check");

static int flash_read_abs(uint32_t address, void *dst, size_t len)
{
	const struct device *flash = CODE_FLASH;

	if (!device_is_ready(flash)) {
		return -ENODEV;
	}

	return flash_read(flash, address, dst, len) != 0 ? -EIO : 0;
}

static int flash_read_image(uint32_t img_off, void *dst, size_t len)
{
	const struct device *flash = CODE_FLASH;

	if (!device_is_ready(flash)) {
		return -ENODEV;
	}

	return flash_read(flash, CODE_PART_OFF + img_off, dst, len) != 0 ? -EIO : 0;
}

static int hash_flash_region(psa_hash_operation_t *operation, uint32_t address, uint32_t size)
{
	static uint8_t chunk[HASH_CHUNK_SIZE];
	psa_status_t status;

	for (uint32_t off = 0; off < size; off += HASH_CHUNK_SIZE) {
		const size_t chunk_len = MIN(HASH_CHUNK_SIZE, size - off);
		int rc;

		rc = flash_read_abs(address + off, chunk, chunk_len);
		if (rc != 0) {
			return rc;
		}

		status = psa_hash_update(operation, chunk, chunk_len);
		if (status != PSA_SUCCESS) {
			MFG_LOG_ERR("psa_hash_update failed: %d\n", (int)status);
			return -EIO;
		}
	}

	return 0;
}

static int hash_image_region(psa_hash_operation_t *operation, uint32_t img_off, uint32_t size)
{
	static uint8_t chunk[HASH_CHUNK_SIZE];
	psa_status_t status;

	for (uint32_t off = 0; off < size; off += HASH_CHUNK_SIZE) {
		const size_t chunk_len = MIN(HASH_CHUNK_SIZE, size - off);
		int rc;

		rc = flash_read_image(img_off + off, chunk, chunk_len);
		if (rc != 0) {
			return rc;
		}

		status = psa_hash_update(operation, chunk, chunk_len);
		if (status != PSA_SUCCESS) {
			MFG_LOG_ERR("psa_hash_update failed: %d\n", (int)status);
			return -EIO;
		}
	}

	return 0;
}

static int verify_flash_digest(uint32_t address, uint32_t size, const uint8_t *expected)
{
	psa_hash_operation_t operation = PSA_HASH_OPERATION_INIT;
	psa_status_t status;
	int rc;

	status = psa_hash_setup(&operation, PSA_ALG_SHA_256);
	if (status != PSA_SUCCESS) {
		MFG_LOG_ERR("psa_hash_setup failed: %d\n", (int)status);
		return -EIO;
	}

	rc = hash_flash_region(&operation, address, size);
	if (rc != 0) {
		psa_hash_abort(&operation);
		return rc;
	}

	status = psa_hash_verify(&operation, expected, MFG_DIGEST_LEN);
	if (status == PSA_SUCCESS) {
		return 0;
	}

	if (status == PSA_ERROR_INVALID_SIGNATURE) {
		return -EINVAL;
	}

	MFG_LOG_ERR("psa_hash_verify failed: %d\n", (int)status);
	psa_hash_abort(&operation);
	return -EIO;
}

static int find_image_tlv(const struct image_header *hdr, uint16_t tlv_type,
			  uint8_t *payload, size_t payload_max, uint16_t *payload_len)
{
	const uint32_t area_off = hdr->ih_hdr_size + hdr->ih_img_size;
	struct image_tlv_info info;
	struct image_tlv tlv;
	uint32_t tlv_off;
	uint32_t tlv_end;
	uint32_t prot_end;
	int rc;

	rc = flash_read_image(area_off, &info, sizeof(info));
	if (rc != 0) {
		return rc;
	}

	if (info.it_magic == IMAGE_TLV_PROT_INFO_MAGIC) {
		if (hdr->ih_protect_tlv_size != info.it_tlv_tot) {
			return -EINVAL;
		}

		prot_end = area_off + hdr->ih_protect_tlv_size;
		rc = flash_read_image(prot_end, &info, sizeof(info));
		if (rc != 0) {
			return rc;
		}

		tlv_end = area_off + hdr->ih_protect_tlv_size + info.it_tlv_tot;
		tlv_off = area_off + sizeof(info);
	} else {
		if (hdr->ih_protect_tlv_size != 0U) {
			return -EINVAL;
		}
		if (info.it_magic != IMAGE_TLV_INFO_MAGIC) {
			return -EINVAL;
		}

		prot_end = area_off;
		tlv_end = area_off + info.it_tlv_tot;
		tlv_off = area_off + sizeof(info);
	}

	while (tlv_off < tlv_end) {
		if (hdr->ih_protect_tlv_size > 0U && tlv_off == prot_end) {
			tlv_off += sizeof(struct image_tlv_info);
		}

		if (tlv_off + sizeof(tlv) > tlv_end) {
			return -EINVAL;
		}

		rc = flash_read_image(tlv_off, &tlv, sizeof(tlv));
		if (rc != 0) {
			return rc;
		}

		if (tlv_off + sizeof(tlv) + tlv.it_len > tlv_end) {
			return -EINVAL;
		}

		if (tlv.it_type == tlv_type) {
			if (tlv.it_len > payload_max) {
				return -ENOSPC;
			}

			rc = flash_read_image(tlv_off + sizeof(tlv), payload, tlv.it_len);
			if (rc != 0) {
				return rc;
			}

			*payload_len = tlv.it_len;
			return 0;
		}

		tlv_off += sizeof(tlv) + tlv.it_len;
	}

	return -ENOENT;
}

static int verify_mcuboot_image_hash(const struct image_header *hdr,
				     psa_algorithm_t alg, const uint8_t *expected,
				     size_t expected_len)
{
	psa_hash_operation_t operation = PSA_HASH_OPERATION_INIT;
	psa_status_t status;
	const uint32_t img_hash_len = hdr->ih_hdr_size + hdr->ih_img_size +
				      hdr->ih_protect_tlv_size;
	int rc;

	status = psa_hash_setup(&operation, alg);
	if (status != PSA_SUCCESS) {
		MFG_LOG_ERR("psa_hash_setup failed: %d\n", (int)status);
		return -EIO;
	}

	rc = hash_image_region(&operation, 0, img_hash_len);
	if (rc != 0) {
		psa_hash_abort(&operation);
		return rc;
	}

	status = psa_hash_verify(&operation, expected, expected_len);
	if (status == PSA_SUCCESS) {
		return 0;
	}

	if (status == PSA_ERROR_INVALID_SIGNATURE) {
		return -EINVAL;
	}

	MFG_LOG_ERR("psa_hash_verify failed: %d\n", (int)status);
	psa_hash_abort(&operation);
	return -EIO;
}

static void validate_image_digest(uint32_t address, uint32_t size, const uint8_t *digest)
{
	int rc;

	MFG_LOG_INF("Validating %u bytes at 0x%08x...", size, address);

	if (digest == NULL || mfg_digest_is_zero(digest)) {
		MFG_LOG_INF(" SKIP (no expected digest provided at build time)\n");
		return;
	}

	if (size == 0U) {
		MFG_LOG_ERR(" FAIL (zero-length area)\n");
		recovery_suspend(false);
	}

	rc = verify_flash_digest(address, size, digest);
	if (rc == 0) {
		MFG_LOG_INF(" OK\n");
		return;
	}

	if (rc == -EINVAL) {
		MFG_LOG_ERR(" FAIL (digest mismatch)\n");
	} else {
		MFG_LOG_ERR(" FAIL (verification error %d)\n", rc);
	}
	recovery_suspend(false);
}

static void validate_manufacturing_app(void)
{
	struct image_header hdr;
	uint8_t expected_hash[IMAGE_SHA512_HASH_LEN];
	uint16_t hash_tlv_len;
	psa_algorithm_t alg;
	const char *hash_name;
	size_t hash_len;
	int rc;

	MFG_LOG_INF("Validating Manufacturing application (self-check)...");

	rc = flash_read_image(0, &hdr, sizeof(hdr));
	if (rc != 0) {
		MFG_LOG_ERR(" FAIL (cannot read image header: %d)\n", rc);
		recovery_suspend(false);
	}

	if (hdr.ih_magic != IMAGE_MAGIC) {
		MFG_LOG_ERR(" FAIL (invalid image magic 0x%08x)\n", hdr.ih_magic);
		recovery_suspend(false);
	}

	rc = find_image_tlv(&hdr, IMAGE_TLV_SHA256, expected_hash, sizeof(expected_hash),
			    &hash_tlv_len);
	if (rc == 0) {
		alg = PSA_ALG_SHA_256;
		hash_name = "SHA256";
		hash_len = IMAGE_HASH_LEN;
	} else {
		rc = find_image_tlv(&hdr, IMAGE_TLV_SHA512, expected_hash,
				    sizeof(expected_hash), &hash_tlv_len);
		if (rc == -ENOENT) {
			MFG_LOG_ERR(" FAIL (no IMAGE_TLV_SHA256 or IMAGE_TLV_SHA512 in trailer)\n");
			recovery_suspend(false);
		}
		if (rc != 0) {
			MFG_LOG_ERR(" FAIL (cannot read hash TLV: %d)\n", rc);
			recovery_suspend(false);
		}

		alg = PSA_ALG_SHA_512;
		hash_name = "SHA512";
		hash_len = IMAGE_SHA512_HASH_LEN;
	}

	if (hash_tlv_len != hash_len) {
		MFG_LOG_ERR(" FAIL (%s TLV length %u, expected %zu)\n",
			    hash_name, hash_tlv_len, hash_len);
		recovery_suspend(false);
	}

	rc = verify_mcuboot_image_hash(&hdr, alg, expected_hash, hash_len);
	if (rc == 0) {
		MFG_LOG_INF(" OK (%s)\n", hash_name);
		return;
	}

	if (rc == -EINVAL) {
		MFG_LOG_ERR(" FAIL (%s hash mismatch)\n", hash_name);
	} else {
		MFG_LOG_ERR(" FAIL (%s hash verification error %d)\n", hash_name, rc);
	}
	recovery_suspend(false);
}

/* ---------------------------------------------------------------------------
 * Step 3 entry point
 * ---------------------------------------------------------------------------
 */
void step3_image_validate_all(void)
{
	psa_status_t status;

	MFG_LOG_STEP("Validating images");

	status = psa_crypto_init();
	if (status != PSA_SUCCESS && status != PSA_ERROR_ALREADY_EXISTS) {
		MFG_LOG_ERR("psa_crypto_init failed: %d\n", (int)status);
		recovery_suspend(false);
	}

	if (mfg_key_blob_get() == NULL) {
		MFG_LOG_ERR("Manufacturing TLV key blob is missing or invalid.\n");
		recovery_suspend(false);
	}

	validate_manufacturing_app();

	/* BL0, BL2 slots, application candidate, and other images pass expected
	 * digests via protected TLV entries (address, size, SHA-256).
	 */
	for (size_t i = 0; i < mfg_key_blob_digest_count(); i++) {
		const struct mfg_area_digest *entry = mfg_key_blob_digest_get(i);

		if (entry == NULL) {
			break;
		}
		validate_image_digest(entry->address, entry->size, entry->digest);
	}
}
```

## src/image_validation.h
```c
/*
 * Copyright (c) 2026 Nordic Semiconductor ASA
 *
 * SPDX-License-Identifier: LicenseRef-Nordic-5-Clause
 */

/**
 * @file image_validation.h
 *
 * Step 3: Validate digests of all sub-images in the initial image.
 */

#ifndef IMAGE_VALIDATION_H_
#define IMAGE_VALIDATION_H_

/**
 * @brief Step 3: Validate all sub-image digests.
 *
 * Checks SHA-256 digests of:
 *   - Manufacturing application (MCUboot IMAGE_TLV_SHA256/SHA512 self-check)
 *   - BL0/BL1/BL2 slots, application candidate, and other images (manufacturing
 *     TLV area digests)
 *
 * Suspends execution if any verification fails.
 */
void step3_image_validate_all(void);

#endif /* IMAGE_VALIDATION_H_ */
```

## src/kmu_check.c
```c
/*
 * Copyright (c) 2025 Nordic Semiconductor ASA
 *
 * SPDX-License-Identifier: LicenseRef-Nordic-5-Clause
 */

/**
 * Step 2 — Validate that no IKG seed or KeyRAM random data is already present.
 *
 * Check strategy:
 *
 * IKG seed presence:
 *   hw_unique_key_are_any_written() directly queries the KMU slot for the
 *   CRACEN_KMU_KEY_USAGE_SCHEME_SEED entry via cracen_kmu_get_key_slot().
 *   This is more reliable than trying to derive the IAK via psa_export_public_key(),
 *   which returns driver-specific error codes that vary depending on heap state
 *   and CRACEN configuration.
 *     - returns true  → seed IS present (error — must suspend).
 *     - returns false → seed not present (good).
 *
 * KeyRAM random slots (PROTECTED_RAM_INVALIDATION_DATA_SLOT1 = 248,
 *                      PROTECTED_RAM_INVALIDATION_DATA_SLOT2 = 249):
 *   We probe the KMU slot directly via cracen_kmu_get_key_slot():
 *     - PSA_SUCCESS                → slot occupied (error — must suspend).
 *     - any other status           → slot empty (good).
 */

#include "kmu_check.h"
#include "mfg_log.h"
#include "recovery.h"

#include <psa/crypto.h>
#include <cracen/cracen_kmu.h>
#include <cracen_psa_kmu.h>
#include <cracen_psa_key_ids.h>
#include <hw_unique_key.h>

/* ---------------------------------------------------------------------------
 * IKG seed presence check via direct KMU slot query
 * ---------------------------------------------------------------------------
 */
static void check_ikg_seed_slots(void)
{
	MFG_LOG_INF("Verifying KMU IKG seed slots...");

	if (hw_unique_key_are_any_written()) {
		MFG_LOG_INF(" FAIL (not empty)\n");
		MFG_LOG_ERR("\nSeems IKG seed is already provisioned. Secrecy and entropy level\n");
		MFG_LOG_ERR("of that data cannot be trusted.\n");
		recovery_suspend(false);
	}

	MFG_LOG_INF(" OK (empty)\n");
}

/* ---------------------------------------------------------------------------
 * KeyRAM random slot presence check
 *
 * cracen_kmu_get_key_slot() is the same direct KMU probe used internally by
 * hw_unique_key_are_any_written(). It returns PSA_SUCCESS if and only if the
 * slot holds a valid key, without performing any cryptographic operation.
 *
 * Slot numbers are defined in cracen_kmu.h:
 *   PROTECTED_RAM_INVALIDATION_DATA_SLOT1 = 248
 *   PROTECTED_RAM_INVALIDATION_DATA_SLOT2 = 249
 * ---------------------------------------------------------------------------
 */
static void check_one_keyram_slot(int slot_id)
{
	MFG_LOG_INF("Verifying KMU KeyRAM random slot %d...", slot_id);

	psa_key_id_t key_id = PSA_KEY_HANDLE_FROM_CRACEN_KMU_SLOT(
		CRACEN_KMU_KEY_USAGE_SCHEME_PROTECTED, slot_id);

	psa_key_lifetime_t lifetime;
	psa_drv_slot_number_t slot_number;
	psa_status_t status = cracen_kmu_get_key_slot(key_id, &lifetime, &slot_number);
	return;
	if (status != PSA_SUCCESS) {
		MFG_LOG_INF(" OK (empty)\n");
		return;
	}

	MFG_LOG_INF(" FAIL (not empty)\n");
	MFG_LOG_ERR("\nSeems KeyRAM random (slot %d) is already provisioned.\n", slot_id);
	MFG_LOG_ERR("Secrecy and entropy level of that data cannot be trusted.\n");
	recovery_suspend(false);
}

/* ---------------------------------------------------------------------------
 * Step 2 entry point
 * ---------------------------------------------------------------------------
 */
void step2_kmu_check_empty(void)
{
	MFG_LOG_STEP("Checking KMU slots");

	check_ikg_seed_slots();

	check_one_keyram_slot(PROTECTED_RAM_INVALIDATION_DATA_SLOT1);
	check_one_keyram_slot(PROTECTED_RAM_INVALIDATION_DATA_SLOT2);
}
```

## src/mfg_key_blob.c
```c
/*
 * Copyright (c) 2026 Nordic Semiconductor ASA
 *
 * SPDX-License-Identifier: LicenseRef-Nordic-5-Clause
 */

#include "mfg_key_blob.h"

#include <bootutil/bootutil_public.h>
#include <errno.h>
#include <stddef.h>
#include <string.h>
#include <zephyr/device.h>
#include <zephyr/devicetree.h>
#include <zephyr/drivers/flash.h>
#include <zephyr/logging/log.h>
#include <zephyr/storage/flash_map.h>

LOG_MODULE_REGISTER(mfg_key_blob, LOG_LEVEL_INF);

#define MFG_IMAGE_PARTITION DT_CHOSEN(zephyr_code_partition)
#define MFG_FLASH           DEVICE_DT_GET(PARTITION_NODE_MTD(MFG_IMAGE_PARTITION))
#define MFG_PARTITION_BASE  PARTITION_NODE_OFFSET(MFG_IMAGE_PARTITION)

#ifndef CONFIG_NCS_MCUBOOT_MANUFACTURING_TLV_ID
#define MFG_MANUFACTURING_TLV_ID 0x00A2
#else
#define MFG_MANUFACTURING_TLV_ID CONFIG_NCS_MCUBOOT_MANUFACTURING_TLV_ID
#endif

/* Upper bound for the manufacturing TLV payload read from flash. */
#define MFG_TLV_PAYLOAD_MAX 1024U

BUILD_ASSERT(DT_NODE_EXISTS(MFG_IMAGE_PARTITION),
	     "zephyr,code-partition is required to locate the signed image");

static uint8_t tlv_payload[MFG_TLV_PAYLOAD_MAX];
static struct mfg_key_blob blob_cache;
static const struct mfg_area_digest *digest_cache;
static size_t digest_count;
static const struct mfg_key_blob *blob_ptr;
static bool blob_loaded;

static int partition_read(uint32_t part_off, void *dst, size_t len)
{
	int rc;

	rc = flash_read(MFG_FLASH, MFG_PARTITION_BASE + part_off, dst, len);
	return rc != 0 ? -EIO : 0;
}

static int find_protected_tlv(const struct image_header *hdr, uint16_t tlv_type,
			      uint32_t *payload_off, uint16_t *payload_len)
{
	const uint32_t area_off = hdr->ih_hdr_size + hdr->ih_img_size;
	struct image_tlv_info info;
	struct image_tlv tlv;
	uint32_t tlv_off;
	uint32_t prot_end;

	if (hdr->ih_protect_tlv_size == 0U) {
		return -ENOENT;
	}

	if (partition_read(area_off, &info, sizeof(info)) != 0) {
		return -EIO;
	}

	if (info.it_magic != IMAGE_TLV_PROT_INFO_MAGIC) {
		LOG_ERR("Missing protected TLV info magic at 0x%x", area_off);
		return -EINVAL;
	}

	if (info.it_tlv_tot != hdr->ih_protect_tlv_size) {
		LOG_ERR("Protected TLV size mismatch (hdr %u, info %u)",
			hdr->ih_protect_tlv_size, info.it_tlv_tot);
		return -EINVAL;
	}

	prot_end = area_off + hdr->ih_protect_tlv_size;
	tlv_off = area_off + sizeof(info);

	while (tlv_off + sizeof(tlv) <= prot_end) {
		if (partition_read(tlv_off, &tlv, sizeof(tlv)) != 0) {
			return -EIO;
		}

		if (tlv_off + sizeof(tlv) + tlv.it_len > prot_end) {
			LOG_ERR("Protected TLV entry overruns area");
			return -EINVAL;
		}

		if (tlv.it_type == tlv_type) {
			*payload_off = tlv_off + sizeof(tlv);
			*payload_len = tlv.it_len;
			return 0;
		}

		tlv_off += sizeof(tlv) + tlv.it_len;
	}

	return -ENOENT;
}

static const struct mfg_key_blob *parse_blob(const uint8_t *payload, uint16_t len)
{
	size_t digest_bytes;

	if (len < MFG_KEY_BLOB_FIXED_SIZE) {
		LOG_ERR("Manufacturing TLV too small (%u B)", len);
		return NULL;
	}

	memcpy(&blob_cache, payload, MFG_KEY_BLOB_FIXED_SIZE);

	if (blob_cache.magic != MFG_KEY_BLOB_MAGIC) {
		LOG_ERR("Bad magic 0x%08x (expected 0x%08x)",
			(unsigned int)blob_cache.magic,
			(unsigned int)MFG_KEY_BLOB_MAGIC);
		return NULL;
	}

	if (blob_cache.version != MFG_KEY_BLOB_VERSION) {
		LOG_ERR("Unsupported version %u (expected %u)",
			(unsigned int)blob_cache.version,
			(unsigned int)MFG_KEY_BLOB_VERSION);
		return NULL;
	}

	if (blob_cache.total_size < MFG_KEY_BLOB_FIXED_SIZE ||
	    blob_cache.total_size > len) {
		LOG_ERR("Bad total_size %u (payload %u, min %zu)",
			(unsigned int)blob_cache.total_size, len,
			MFG_KEY_BLOB_FIXED_SIZE);
		return NULL;
	}

	digest_bytes = blob_cache.total_size - MFG_KEY_BLOB_FIXED_SIZE;
	if ((digest_bytes % MFG_AREA_DIGEST_SIZE) != 0U) {
		LOG_ERR("Trailing digest area size %zu is not a multiple of %zu",
			digest_bytes, MFG_AREA_DIGEST_SIZE);
		return NULL;
	}

	digest_count = digest_bytes / MFG_AREA_DIGEST_SIZE;
	digest_cache = (const struct mfg_area_digest *)(payload + MFG_KEY_BLOB_FIXED_SIZE);

	return &blob_cache;
}

static const struct mfg_key_blob *load_blob(void)
{
	struct image_header hdr;
	uint32_t payload_off;
	uint16_t payload_len;
	int rc;

	if (!device_is_ready(MFG_FLASH)) {
		LOG_ERR("Flash device for code partition is not ready");
		return NULL;
	}

	rc = partition_read(0, &hdr, sizeof(hdr));
	if (rc != 0) {
		LOG_ERR("Failed to read image header: %d", rc);
		return NULL;
	}

	if (hdr.ih_magic != IMAGE_MAGIC) {
		LOG_ERR("Invalid image magic 0x%08x", hdr.ih_magic);
		return NULL;
	}

	rc = find_protected_tlv(&hdr, MFG_MANUFACTURING_TLV_ID, &payload_off, &payload_len);
	if (rc == -ENOENT) {
		LOG_ERR("Manufacturing TLV 0x%04x not found in protected area",
			MFG_MANUFACTURING_TLV_ID);
		return NULL;
	}
	if (rc != 0) {
		return NULL;
	}

	if (payload_len > sizeof(tlv_payload)) {
		LOG_ERR("Manufacturing TLV payload %u B exceeds buffer %zu B",
			payload_len, sizeof(tlv_payload));
		return NULL;
	}

	rc = partition_read(payload_off, tlv_payload, payload_len);
	if (rc != 0) {
		LOG_ERR("Failed to read manufacturing TLV payload: %d", rc);
		return NULL;
	}

	return parse_blob(tlv_payload, payload_len);
}

const struct mfg_key_blob *mfg_key_blob_get(void)
{
	if (!blob_loaded) {
		blob_ptr = load_blob();
		blob_loaded = true;
	}
	return blob_ptr;
}

size_t mfg_key_blob_digest_count(void)
{
	if (!blob_loaded) {
		(void)mfg_key_blob_get();
	}
	return digest_count;
}

const struct mfg_area_digest *mfg_key_blob_digest_get(size_t index)
{
	if (!blob_loaded) {
		(void)mfg_key_blob_get();
	}
	if (index >= digest_count) {
		return NULL;
	}
	return &digest_cache[index];
}
```

## src/mfg_key_blob.h
```c
/*
 * Copyright (c) 2026 Nordic Semiconductor ASA
 *
 * SPDX-License-Identifier: LicenseRef-Nordic-5-Clause
 */

/*
 * Manufacturing key blob embedded in the running image's MCUboot protected
 * TLV area (see CONFIG_NCS_MCUBOOT_MANUFACTURING_TLV_ID). The blob is packed
 * at build time by scripts/pack_mfg_keys.py and covered by the image signature.
 *
 * Source of truth for the fixed key layout: this file. The Python packer
 * mirrors it. Area digests are appended after the fixed fields as a sequence
 * of struct mfg_area_digest entries.
 */

#ifndef MFG_KEY_BLOB_H_
#define MFG_KEY_BLOB_H_

#include <stdbool.h>
#include <stddef.h>
#include <stdint.h>

#define MFG_KEY_BLOB_MAGIC   0x4B47464DU   /* 'M','F','G','K' little-endian */
#define MFG_KEY_BLOB_VERSION 1U

#define MFG_ED25519_PUBKEY_LEN 32U
#define MFG_IKG_SEED_LEN       48U
#define MFG_KEYRAM_RAND_LEN    16U
#define MFG_ED25519_SIG_LEN    64U
#define MFG_DIGEST_LEN         32U

struct __packed mfg_area_digest {
	uint32_t address;
	uint32_t size;
	uint8_t  digest[MFG_DIGEST_LEN];
};

struct __packed mfg_key_blob {
	uint32_t magic;
	uint16_t version;
	uint16_t reserved;
	uint32_t total_size;

	uint8_t  urot_pubkey_gen0[MFG_ED25519_PUBKEY_LEN];
	uint8_t  urot_pubkey_gen1[MFG_ED25519_PUBKEY_LEN];
	uint8_t  mfg_app_pubkey  [MFG_ED25519_PUBKEY_LEN];

	uint8_t  ikg_seed       [MFG_IKG_SEED_LEN];
	uint8_t  keyram_random0 [MFG_KEYRAM_RAND_LEN];
	uint8_t  keyram_random1 [MFG_KEYRAM_RAND_LEN];

	uint8_t  urot_pubkey_gen0_sig[MFG_ED25519_SIG_LEN];
	uint8_t  urot_pubkey_gen1_sig[MFG_ED25519_SIG_LEN];
};

#define MFG_KEY_BLOB_FIXED_SIZE sizeof(struct mfg_key_blob)
#define MFG_AREA_DIGEST_SIZE    sizeof(struct mfg_area_digest)

/* Cached pointer to a validated blob, or NULL if the TLV is missing or
 * invalid. Validation checks magic, version, and total_size bounds.
 */
const struct mfg_key_blob *mfg_key_blob_get(void);

/* Number of area digest entries appended after the fixed blob fields. */
size_t mfg_key_blob_digest_count(void);

/* Return digest entry i, or NULL if out of range. */
const struct mfg_area_digest *mfg_key_blob_digest_get(size_t index);

/* True if a buffer of MFG_DIGEST_LEN bytes is all zeros (placeholder). */
static inline bool mfg_digest_is_zero(const uint8_t *digest)
{
	for (size_t i = 0; i < MFG_DIGEST_LEN; i++) {
		if (digest[i] != 0U) {
			return false;
		}
	}
	return true;
}

#endif /* MFG_KEY_BLOB_H_ */
```

## src/notes.c
```c
	/*
	 * Missing pieces from the B0.
	 */

	/* Is BL2 present and valid?
	 * - if not present or not valid - enable authenticated erase all.
	 */

	/* Check the current LCS value:
	 * - A&T: continue to BL2
	 * - check BL2 signature otherwise
	 *   - if signature is valid - continue to BL2
	 *   - otherwise - enable authenticated erase all.
	 */

	/*
	 * Missing pieces from BL2.
	 */

	/* Check LCS. */
	/* Secured - check app candidate presence and valididty.
	 * Otherwise - verify the provisioning image or update candidate (slot 0) digest.
	 * If Assembly and test - jump directly into the provisioning image.
	 * If Secured or Decomissioned - check application signature.
	 *  - if invalid - enable authenticated erase all.
	 *  - if valid - jump to the application.
	 * If PROT Provisioning - check the provisioning image signature.
	 *  - if invalid - enable authenticated erase all.
	 *  - if valid - jump to the provisioning image.
	 */

	/*
	 * Steps to be performed in a trusted manufacturing environment.
	 */

	/* Check the correctness of the B0 (NSIB). */
	/* Check the correctness of the B1 (MCUboot). */
	/* Check the correctness of the provisioning image (self). */
	/* Check the presence of the application update candidate. */
	/* Check the updateability of the application update candidate. */
	/* Check essential fields of the UICR. */

	/* Provision IKG seed. */
	/* Open connection to the external provisioning tool (if needed). */
	/* Provision secure boot keys. */
	/* Provision ADAC keys. */

	/* Configure erase protection.*/
	/* Set LCS to "PROT Provisioning". */
	/* Check erase protection value .*/
	/* Check the current LCS value. */

	/*
	 * Steps to be performed in an untrusted manufacturing environment.
	 */

	/* The the product (PCB, connections, sensors, etc.). */
	/* Open a secure connection for provisioning of other assets. */
	/* Set LCS to "Secured". */
	/* Schedule installation of the application candidate. */
	/* Revoke Manufacturing Tool (provisioning image) verification key. */
	/* Reboot. */

	/* At this point the BL2 (MCUboot) should install the main application.
	 * The update process should overwrite the provisioning image.
	 * As a result, no other actions can or should be performed by this application.
	 */
```
