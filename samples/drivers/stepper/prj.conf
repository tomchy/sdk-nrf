## CMakeLists.txt
```
# Copyright (c) 2022 Tomasz Chyrowicz
# SPDX-License-Identifier: Apache-2.0

cmake_minimum_required(VERSION 3.20.0)
find_package(Zephyr REQUIRED HINTS $ENV{ZEPHYR_BASE})
project(stepper)

target_sources(app PRIVATE src/main.c)
```

## prj.conf
```kconfig
# Copyright (c) 2022 Tomasz Chyrowicz
# SPDX-License-Identifier: Apache-2.0

CONFIG_GPIO=y
CONFIG_STEPPER=y
CONFIG_COUNTER_TIMER2=y

CONFIG_LOG=y
CONFIG_STEPPER_LOG_LEVEL_DBG=y
CONFIG_DK_LIBRARY=y

CONFIG_FPU=y
CONFIG_NEWLIB_LIBC=y
CONFIG_NEWLIB_LIBC_FLOAT_PRINTF=y
```

## boards/nrf52840dk_nrf52840.overlay
```dts
/*
 * Copyright (c) 2022 Tomasz Chyrowicz
 *
 * SPDX-License-Identifier: Apache-2.0
 */

/ {
	stepper_drivers {
		stepper1: stepper_1 {
			compatible = "zephyr,stepper";
			status = "okay";

			dir-gpios = <&gpio1 10 GPIO_ACTIVE_HIGH>;
			step-gpios = <&gpio1 11 GPIO_ACTIVE_HIGH>;
			m1-gpios = <&gpio1 12 GPIO_ACTIVE_HIGH>;
			m2-gpios = <&gpio1 13 GPIO_ACTIVE_HIGH>;
			nstby-gpios = <&gpio1 14 GPIO_ACTIVE_HIGH>;
			counter-timer = <&timer2>;

			distance-per-step-mm = <1>;
			max-acceleration = <50>;
			max-velocity = <200>;
		};
	};
};
```

## boards/nrf5340dk_nrf5340_cpuapp.overlay
```dts
/*
 * Copyright (c) 2022 Tomasz Chyrowicz
 *
 * SPDX-License-Identifier: Apache-2.0
 */

/ {
	stepper_drivers {
		stepper1: stepper_1 {
			compatible = "zephyr,stepper";
			status = "okay";

			dir-gpios = <&gpio0 30 GPIO_ACTIVE_HIGH>;
			step-gpios = <&gpio0 31 GPIO_ACTIVE_HIGH>;
			m1-gpios = <&gpio1 12 GPIO_ACTIVE_HIGH>;
			m2-gpios = <&gpio1 13 GPIO_ACTIVE_HIGH>;
			nstby-gpios = <&gpio0 29 GPIO_ACTIVE_HIGH>;
			counter-timer = <&timer2>;

			distance-per-step-mm = <1>;
			max-acceleration = <2>;
			max-velocity = <10>;
		};
	};
};
```

## src/main.c
```c
/*
 * Copyright (c) 2022 Tomasz Chyrowicz
 *
 * SPDX-License-Identifier: Apache-2.0
 */

#include <zephyr/zephyr.h>
#include <zephyr/drivers/gpio.h>
#include <drivers/stepper.h>
#include <zephyr/logging/log.h>
#include <dk_buttons_and_leds.h>

/* 1000 msec = 1 sec */
#define SLEEP_TIME_MS   1000

/* The devicetree node identifier for the "led0" alias. */
#define LED0_NODE DT_ALIAS(led0)
#define STEPPER0_NODE DT_NODELABEL(stepper1)

LOG_MODULE_REGISTER(app, LOG_LEVEL_INF);

/*
 * A build error on this line means your board is unsupported.
 * See the sample documentation for information on how to fix this.
 */
static const struct gpio_dt_spec led = GPIO_DT_SPEC_GET(LED0_NODE, gpios);
static const struct stepper_dt_spec stepper = STEPPER_DT_SPEC_GET(STEPPER0_NODE);
static int32_t pos = 0;

static void button_changed(uint32_t button_state, uint32_t has_changed)
{
	if (DK_BTN1_MSK & has_changed) {
		if (DK_BTN1_MSK & button_state) {
			/* Button changed its state to pressed */
			static stepper_path_t pos1 = {
				.p = {
					.x = 0,
					.cb = NULL,
				},
				.next = NULL,
			};
			pos -= 100;
			pos1.p.x = pos;
			stepper_set_next_coord(stepper.dev, &pos1);
		}
	}

	else if (DK_BTN2_MSK & has_changed) {
		if (DK_BTN2_MSK & button_state) {
			/* Button changed its state to pressed */
			static stepper_path_t pos2 = {
				.p = {
					.x = 500,
					.cb = NULL,
				},
				.next = NULL,
			};
			pos += 100;
			pos2.p.x = pos;
			stepper_set_next_coord(stepper.dev, &pos2);
		}
	}
}

void main(void)
{
	int ret;

	ret = dk_buttons_init(button_changed);
	if (ret) {
		LOG_ERR("Cannot init buttons (err: %d)", ret);
	}

	if (!device_is_ready(led.port)) {
		return;
	}

	ret = gpio_pin_configure_dt(&led, GPIO_OUTPUT_ACTIVE);
	if (ret < 0) {
		return;
	}

	if (!device_is_ready(stepper.dev)) {
		LOG_ERR("Error: Stepper device %s is not ready",
			stepper.dev->name);
	}

	while (1) {
		ret = gpio_pin_toggle_dt(&led);
		if (ret < 0) {
			return;
		}
		k_msleep(SLEEP_TIME_MS);
	}
}
```
