## applications/smeeze/Kconfig
```kconfig
#
# Copyright (c) 2022 Nordic Semiconductor
#
# SPDX-License-Identifier: LicenseRef-Nordic-5-Clause
#

if USB
config USB_DEVICE_PID
	default 0x53A0
endif

# How often sensor data is read
config WEATHER_CHECK_PERIOD_SECONDS
	int
	default 60

# Delay after app initialization
config FIRST_WEATHER_CHECK_DELAY_SECONDS
	int
	default 5

# Delay after joining the network
config FIND_SENSOR_DELAY_SECONDS
	int
	default 3

# Interval between sending identify queries
config FIND_SENSOR_RETRY_INTERVAL_SECONDS
	int
	default 10

source "Kconfig.zephyr"

module = SMEEZE
module-str = Smeeze
source "subsys/logging/Kconfig.template.log_config"

module = SMEEZE_WSTATION
module-str = Smeeze - weather station module
source "subsys/logging/Kconfig.template.log_config"

module = SMEEZE_DOOR_LOCK
module-str = Smeeze - door lock module
source "subsys/logging/Kconfig.template.log_config"

module = SMEEZE_SFINDER
module-str = Smeeze - temperature sensor finder
source "subsys/logging/Kconfig.template.log_config"

module = SMEEZE_SMEEZE
module-str = Smeeze - the automatic door opening/closing
source "subsys/logging/Kconfig.template.log_config"
```

## applications/smeeze/sample.yaml
```yaml
sample:
  name: Smeeze
  description: Smeeze - the smart breeze
tests:
  applications.smeeze:
    build_only: true
    platform_allow: thingy53_nrf5340_cpuapp
    tags: ci_build
    extra_args: CONF_FILE=prj_release.conf
    integration_platforms:
      - thingy53_nrf5340_cpuapp
  applications.smeeze.debug:
    build_only: true
    platform_allow: thingy53_nrf5340_cpuapp
    tags: ci_build debug
    extra_args: CONF_FILE=prj.conf
```

## drivers/stepper/Kconfig
```kconfig
# Stepper motor driver
#
# Copyright (c) 2022 Tomasz Chyrowicz
#
# SPDX-License-Identifier: Apache-2.0

menuconfig STEPPER
	bool "Stepper motor Driver"
	imply COUNTER
	help
	  Enable stepper motor driver.

module = STEPPER
module-str = stepper
source "subsys/logging/Kconfig.template.log_config"

if STEPPER

config STEPPER_INIT_PRIORITY
	int "Stepper motor driver initialization priority"
	default 90
	help
	  System initialization priority for the stepper motor driver.

endif # STEPPER
```

## dts/bindings/stepper/zephyr,stepper.yaml
```yaml
# Copyright (c) 2022, Tomasz Chyrowicz
# SPDX-License-Identifier: Apache-2.0

description: Stepper motor driver

compatible: "zephyr,stepper"

include: base.yaml

properties:
    dir-gpios:
        type: phandle-array
        required: true
        description: |
            GPIO of the SOC controlling direction pin of the stepper driver
    step-gpios:
        type: phandle-array
        required: true
        description: |
            GPIO of the SOC controlling step pin of the stepper driver
    m1-gpios:
        type: phandle-array
        required: false
        description: |
            GPIO of the SOC controlling Mode 1 pin of the micro-stepper driver
    m2-gpios:
        type: phandle-array
        required: false
        description: |
            GPIO of the SOC controlling Mode 2 pin of the micro-stepper driver
    nstby-gpios:
        type: phandle-array
        required: false
        description: |
            GPIO of the SOC controlling standby pin of the stepper driver
    counter-timer:
        type: phandle
        required: false
        description: |
            Counter instance to generate the micro-stepper driver pulses
    distance-per-step-mm:
        type: int
        default: 1
        description: |
            Linear travel distance per single motor step [mm/step]
    max-acceleration:
        type: int
        default: 1
        description: |
            Maximum allowed linear acceleration [mm/second^2]
    max-velocity:
        type: int
        default: 10
        description: |
            Maximum allowed linear velocity [mm/second]
```

## samples/bluetooth/ble_app/Kconfig.sysbuild
```kconfig
#
# Copyright (c) 2023 Nordic Semiconductor
#
# SPDX-License-Identifier: LicenseRef-Nordic-5-Clause
#

source "${ZEPHYR_BASE}/share/sysbuild/Kconfig"

config NRF_DEFAULT_IPC_RADIO
	default y

config SUIT_ENVELOPE
	default y

config SUIT_BUILD_FLASH_COMPANION
	default y

config SUIT_ENVELOPE_ROOT_TEMPLATE_FILENAME
	default "root_with_binary_nordic_top_extflash.yaml.jinja2"

config SUIT_BUILD_RECOVERY
	default y
```

## subsys/suit/manifest_banner/Kconfig
```kconfig
#
# Copyright (c) 2024 Nordic Semiconductor ASA
#
# SPDX-License-Identifier: LicenseRef-Nordic-5-Clause
#

config SUIT_MANIFEST_BANNER
	bool "Enable SUIT manifest boot banner"
        default y
        depends on SSF_SUIT_SERVICE_ENABLED
```

## subsys/suit/zcbor_noncanonical_decode/Kconfig
```kconfig
#
# Copyright (c) 2024 Nordic Semiconductor ASA
#
# SPDX-License-Identifier: LicenseRef-Nordic-5-Clause
#

config SUIT_ZCBOR_NONCANONICAL
	bool "ZCBOR extensions to decode noncanonical maps and byte strings"
	depends on ZCBOR
```
